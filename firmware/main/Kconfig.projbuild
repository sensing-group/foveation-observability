## firmware/main/Kconfig.projbuild
```kconfig
menu "WiFi Tomography Node Configuration"

    config WIFI_SSID
        string "WiFi SSID"
        default "CHANGE_ME_SSID"
        help
            WiFi network name (SSID) to connect to.

    config WIFI_PASSWORD
        string "WiFi Password"
        default "CHANGE_ME_PASSWORD"
        help
            WiFi password (WPA2-PSK).

    config SERVER_IP
        string "Server IP Address"
        default "0.0.0.0"
        help
            IP address of the WiFi tomography server.

    config SERVER_PORT
        int "Server UDP Port"
        default 5000
        help
            UDP port for sending HELLO/HEARTBEAT/CSI data.

    config TRIGGER_PORT
        int "Trigger Listen Port"
        default 5001
        help
            UDP port for receiving TRIGGER commands.

    config BURST_PORT
        int "Burst Broadcast Port"
        default 5555
        help
            UDP port for sending burst packets during TX mode.

    config WIFI_CHANNEL
        int "Preferred WiFi Channel"
        range 0 13
        default 11
        help
            Preferred WiFi channel for CSI consistency (0 = auto).
            All nodes should use the same channel for best results.

    config BURST_COUNT
        int "Burst Packet Count"
        range 5 500
        default 10
        help
            Number of broadcast packets to send during TX burst.
            v5.1.1: Reduced from 100 to 10 for faster trigger cycles.
            10 packets × 200µs = 2ms burst time (vs 20ms with 100).

    config BURST_DELAY_US
        int "Burst Inter-Packet Delay (microseconds)"
        range 0 10000
        default 500
        help
            Delay between burst packets in microseconds.

    config MDNS_DISCOVERY
        bool "Enable mDNS server discovery"
        default y
        help
            Query _csi._udp.local at boot to find the server IP automatically.
            Falls back to SERVER_IP if mDNS resolution fails.

    config MDNS_QUERY_TIMEOUT_MS
        int "mDNS query timeout (ms)"
        default 5000
        depends on MDNS_DISCOVERY
        help
            How long to wait for mDNS response at boot.

    config DEBUG_VERBOSE
        bool "Enable verbose debug logging"
        default y
        help
            Enable detailed logging for debugging connectivity issues.

    config ENABLE_BFI_CAPTURE
        bool "Enable opportunistic BFI (beamforming feedback) capture"
        default n
        help
            In addition to CSI sensing, passively capture 802.11 Compressed
            Beamforming Report Action frames (VHT category 21 / HE category 30)
            overheard on the node's channel, and forward the raw body to the
            server as MSG_TYPE_BFI (0x40). Reuses the promiscuous RX path
            already enabled for CSI; the CSI path is unaffected. Opt-in.

endmenu
```
